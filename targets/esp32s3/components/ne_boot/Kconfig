## targets/esp32s3/components/ne_boot/Kconfig
```kconfig
menu "NeuroEdge boot guard (Q-79, TSK-I2f-10)"

    config NEUROEDGE_BOOT_GUARD_MAX
        int "The boot that reaches this count starts in safe mode"
        default 4
        range 2 20
        help
            Every boot counts itself in NVS before anything else runs, and the
            count is cleared once a boot has stayed up for
            NEUROEDGE_BOOT_GUARD_STABLE_MS after its startup. With the default
            of 4, three boots in a row that crash, reset or lose power before
            that leave the fourth in safe mode: serial console only, no
            network, no gate runtime. `bootguard clear` then `reboot` on the
            console leaves it. Ported from zclaw (MAX_BOOT_FAILURES = 4).

    config NEUROEDGE_BOOT_GUARD_STABLE_MS
        int "A boot is stable this long after its startup (ms)"
        default 30000
        range 0 600000
        help
            0 clears the count as soon as startup is done (QEMU OTA test,
            whose boots stop seconds after their last marker).

endmenu
```

## targets/esp32s3/components/ne_console/Kconfig
```kconfig
menu "NeuroEdge serial console (Q-79, TSK-I2f-10)"

    config NEUROEDGE_CONSOLE
        bool "Start the serial console"
        default y
        help
            The owner's way in with a USB cable: status, settings and secrets
            (a secret at a hidden prompt), the boot guard, reboot and factory
            reset. It starts in normal mode after the gate self-test, and is
            all that runs in safe mode. No command moves a pin or calls a tool.

    config NEUROEDGE_CONSOLE_STACK
        int "Console task stack (bytes)"
        default 4096
        range 3072 16384
        depends on NEUROEDGE_CONSOLE

endmenu
```

## targets/esp32s3/components/ne_ota/Kconfig
```kconfig
menu "NeuroEdge OTA (FR-OTA, TSK-S6-01..04)"

    config NEUROEDGE_OTA
        bool "Enable firmware update (A/B, RSA-signed; off by default)"
        default n
        help
            Links the HTTP(S) update path. Without it the device still honours
            A/B rollback when built with CONFIG_BOOTLOADER_APP_ROLLBACK_ENABLE,
            but it never fetches an image: an unsigned developer build cannot
            accept OTA at all.

            An update build layers sdkconfig.ota on sdkconfig.defaults; the RSA
            signing key stays out of the repository (docs/user/nap-firmware.md,
            section 6). The image is verified with the key that signed the
            running app before anything is switched.

    if NEUROEDGE_OTA

        config NEUROEDGE_OTA_URL
            string "Update URL (http:// or https://; empty disables the check)"
            default ""
            help
                Any open HTTP(S) endpoint serving a signed app image; no
                NeuroEdge service or account is involved. Plain HTTP is allowed
                because the image signature is the integrity check; it gives no
                confidentiality. A URL stored in NVS (namespace ne_ota, key
                url) overrides this at runtime.

        config NEUROEDGE_OTA_HTTP_TIMEOUT_MS
            int "HTTP operation timeout (ms)"
            default 20000
            range 1000 120000

        config NEUROEDGE_OTA_ETH
            bool "Bring up Ethernet (QEMU open_eth) for the update check"
            depends on NEUROEDGE_SKIP_NETWORK
            default n
            help
                QEMU emulates no Wi-Fi; sdkconfig.qemu_ota selects this so the
                check runs over QEMU's user-mode network (the host is
                10.0.2.2). On the board the Wi-Fi stack main.c brings up is
                used, and this must stay off.

        config NEUROEDGE_OTA_TEST_BOOTLOOP
            bool "TEST ONLY: reset before this image can be marked valid"
            default n
            help
                For the rollback test (scripts/qemu_ota.sh): the image boots,
                resets itself before the gate self-test, and the bootloader
                rolls back to the previous app on the next boot — the crash /
                boot-loop path of FR-OTA-02. A reset, not a panic: Espressif
                QEMU 9.0 hangs in the panic handler before it prints or
                reboots (measured), so a panic here would prove nothing.
                Never enable this in a shipped image.

        config NEUROEDGE_OTA_TEST_FAIL_SELFTEST
            bool "TEST ONLY: fail the boot self-test before marking valid"
            default n
            help
                For the rollback test (scripts/qemu_ota.sh): the image fails
                the gate self-test, marks itself invalid and reboots into the
                previous app. Never enable this in a shipped image.

    endif
endmenu
```

## targets/esp32s3/main/Kconfig.projbuild
```kconfig
menu "NeuroEdge"

    config NEUROEDGE_SKIP_NETWORK
        bool "Do not bring up the Wi-Fi / TCP-IP stack"
        default n
        help
            For Espressif QEMU (sdkconfig.qemu, TSK-S4-08), which does not
            emulate Wi-Fi. The boot gate self-test still runs; the
            network_ready memory checkpoint is not taken. Leave this off on
            the board: the Q-3 measurement needs the network stack's cost.

    config NEUROEDGE_QEMU
        bool "This image runs on Espressif QEMU"
        default n
        help
            Set by sdkconfig.qemu (TSK-S4-09). Trace sessions then carry
            device_id "qemu", so evidence from the emulator never reads as
            evidence from the board; on the board device_id is the chip's MAC.

endmenu
```
